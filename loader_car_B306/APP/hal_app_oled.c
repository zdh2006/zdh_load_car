/**
 * @file    hal_app_oled.c
 * @brief   OLED显示驱动 — SSD1306 128x64 I2C
 *
 * 基于hal_y_soft_i2c.c的软件I2C接口驱动SSD1306 OLED屏幕
 * 使用6x8像素的ASCII字体, 128/6=21个字符/行, 64/8=8行
 */

#include "hal_app_oled.h"
#include "hal_y_soft_i2c.h"
#include <string.h>

/* ===================== 6x8 ASCII字体表 ===================== */
/* 每个字符6字节, 从空格(0x20)到波浪号(0x7E), 共95个字符 */
static const uint8_t F6x8[][6] = {
    {0x00,0x00,0x00,0x00,0x00,0x00}, // ' ' (0x20)
    {0x00,0x00,0x5F,0x00,0x00,0x00}, // '!'
    {0x00,0x07,0x00,0x07,0x00,0x00}, // '"'
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    {0x08,0x08,0x2A,0x1C,0x08,0x00}, // '~'
};

/* ===================== I2C写命令/数据 ===================== */

static void OLED_WriteCmd(uint8_t cmd)
{
    i2c_start();
    i2c_write_byte(OLED_I2C_ADDR);
    i2c_wait_ack();
    i2c_write_byte(0x00);   /* Co=0, D/C#=0 → 命令 */
    i2c_wait_ack();
    i2c_write_byte(cmd);
    i2c_wait_ack();
    i2c_stop();
}

static void OLED_WriteData(uint8_t dat)
{
    i2c_start();
    i2c_write_byte(OLED_I2C_ADDR);
    i2c_wait_ack();
    i2c_write_byte(0x40);   /* Co=0, D/C#=1 → 数据 */
    i2c_wait_ack();
    i2c_write_byte(dat);
    i2c_wait_ack();
    i2c_stop();
}

/* ===================== OLED初始化 ===================== */

void OLED_Init(void)
{
    HAL_Delay(100);  /* 等待OLED上电稳定 */

    OLED_WriteCmd(0xAE); /* Display OFF */
    OLED_WriteCmd(0x20); /* Set Memory Addressing Mode */
    OLED_WriteCmd(0x02); /* Page Addressing Mode */
    OLED_WriteCmd(0xB0); /* Set Page Start Address for Page Addressing Mode */
    OLED_WriteCmd(0xC8); /* Set COM Output Scan Direction (remapped) */
    OLED_WriteCmd(0x00); /* Set low column address */
    OLED_WriteCmd(0x10); /* Set high column address */
    OLED_WriteCmd(0x40); /* Set start line address */
    OLED_WriteCmd(0x81); /* Set contrast control */
    OLED_WriteCmd(0xFF); /* 最大亮度 */
    OLED_WriteCmd(0xA1); /* Set segment re-map (column 127 mapped to SEG0) */
    OLED_WriteCmd(0xA6); /* Normal display (not inverted) */
    OLED_WriteCmd(0xA8); /* Set multiplex ratio */
    OLED_WriteCmd(0x3F); /* 1/64 duty */
    OLED_WriteCmd(0xA4); /* Output follows RAM content */
    OLED_WriteCmd(0xD3); /* Set display offset */
    OLED_WriteCmd(0x00); /* No offset */
    OLED_WriteCmd(0xD5); /* Set display clock divide ratio/oscillator frequency */
    OLED_WriteCmd(0xF0); /* 最高频率 */
    OLED_WriteCmd(0xD9); /* Set pre-charge period */
    OLED_WriteCmd(0x22);
    OLED_WriteCmd(0xDA); /* Set COM pins hardware configuration */
    OLED_WriteCmd(0x12);
    OLED_WriteCmd(0xDB); /* Set VCOMH deselect level */
    OLED_WriteCmd(0x20);
    OLED_WriteCmd(0x8D); /* Charge Pump Setting */
    OLED_WriteCmd(0x14); /* Enable charge pump */
    OLED_WriteCmd(0xAF); /* Display ON */

    OLED_Clear();
}

/* ===================== 基本操作 ===================== */

void OLED_Display_On(void)
{
    OLED_WriteCmd(0x8D);
    OLED_WriteCmd(0x14);
    OLED_WriteCmd(0xAF);
}

void OLED_Display_Off(void)
{
    OLED_WriteCmd(0x8D);
    OLED_WriteCmd(0x10);
    OLED_WriteCmd(0xAE);
}

void OLED_SetCursor(uint8_t row, uint8_t col)
{
    OLED_WriteCmd(0xB0 + row);                /* 设置页地址(0~7) */
    OLED_WriteCmd(0x00 + (col & 0x0F));       /* 设置列低4位 */
    OLED_WriteCmd(0x10 + ((col >> 4) & 0x0F));/* 设置列高4位 */
}

void OLED_Clear(void)
{
    uint8_t i, j;
    for (i = 0; i < 8; i++)
    {
        OLED_SetCursor(i, 0);
        for (j = 0; j < 128; j++)
        {
            OLED_WriteData(0x00);
        }
    }
}

void OLED_ClearRow(uint8_t row)
{
    uint8_t j;
    if (row > 7) return;
    OLED_SetCursor(row, 0);
    for (j = 0; j < 128; j++)
    {
        OLED_WriteData(0x00);
    }
}

/* ===================== 显示函数 ===================== */

void OLED_ShowChar(uint8_t row, uint8_t col, char ch)
{
    uint8_t i;
    uint8_t c = (uint8_t)ch;

    if (c < 0x20 || c > 0x7E) c = 0x20;  /* 超出范围显示空格 */

    OLED_SetCursor(row, col);
    for (i = 0; i < 6; i++)
    {
        OLED_WriteData(F6x8[c - 0x20][i]);
    }
}

void OLED_ShowString(uint8_t row, uint8_t col, const char *str)
{
    while (*str)
    {
        if (col > 122)  /* 超出屏幕宽度换行 */
        {
            col = 0;
            row++;
        }
        if (row > 7) break;
        OLED_ShowChar(row, col, *str);
        col += 6;
        str++;
    }
}

void OLED_Refresh(void)
{
    /* Page Addressing Mode下写完即刷新, 此处保留接口兼容 */
}
